#include "Wire.h"           //  Подключаем библиотеку для работы с шиной I2C
#include "MAX30105.h"       //  Подключаем библиотеку для работы с модулем
#include "heartRate.h"      //  Подключаем блок для работы с ЧСС (пульс)
MAX30105  particleSensor;    //  Создаём объект для работы с библиотекой
 
const byte RATE_SIZE = 4;   //  Коэффициент усреднения
byte rates[RATE_SIZE];      //  Массив со значениями ЧСС
byte rateSpot = 0;          //  Переменная с порядковым номером значения в массиве
long lastBeat = 0;          //  Время последнего зафиксированного удара
float beatsPerMinute;       //  Создаём переменную для хранения значения ЧСС
int beatAvg;                //  Создаём переменную для хранения усреднённого значения ЧСС
 
void setup()
{
  Serial.begin(115200);                               //  Инициируем работу с монитором последовательного порта на скорости 115200 бод
  Serial.println("Initializing...");                  //  Выводим собощение
  if (!particleSensor.begin(Wire, I2C_SPEED_FAST))    //  Инициируем работу с модулем. Если инициализация не прошла, то
  {
    Serial.println("MAX30105 was not found.");        //  Выводим сообщение об ошибки 
    while (1);                                        //  Зацикливаем
  }
  
  Serial.println("Place your finger on the sensor");  //  Выводим сообщение
  particleSensor.setup();                             //  Устанавливаем настройки для сенсора по умолчанию
  particleSensor.setPulseAmplitudeRed(0x0A);          //  Выключаем КРАСНЫЙ светодиод для того, чтобы модуль начал работу
  particleSensor.setPulseAmplitudeGreen(0);           //  Выключаем ЗЕЛЁНЫЙ светодиод
}
 
void loop()
{
  long irValue = particleSensor.getIR();               //  Считываем значение отражённого ИК-светодиода
  if (checkForBeat(irValue) == true) {                  //  Пульс был зафиксирован?
    long delta = millis() - lastBeat;                   //  Находим дельту по времени между ударами
    lastBeat = millis();                                //  Обновляем счётчик
    beatsPerMinute = 60 / (delta / 1000.0);             //  Вычисляем количество ударов в минуту
    if (beatsPerMinute < 255 && beatsPerMinute > 20) {  //  Если количество ударов в минуту находится в промежутке между 20 и 255
      rates[rateSpot++] = (byte)beatsPerMinute;         //  Записываем значение
      rateSpot %= RATE_SIZE;                            //  Задаём порядковый номер значения в массиве, возвращая остаток от деления и присваивая его переменной rateSpot
      beatAvg = 0;                                      //  Обнуляем переменную
      for (byte x = 0 ; x < RATE_SIZE ; x++) {          //  В цикле выполняем усреднение значений
        beatAvg += rates[x];                            //  Складываем значение в массива
      }
      beatAvg /= RATE_SIZE;                           
    }
  }
  Serial.print("IR=");                                  //  Выводим в монитор последовательного порта текст про значение ИК-светодиода
  Serial.print(irValue);                                //  Выводим в монитор последовательного порта значение с ИК-светодиода
  Serial.print(", BPM=");                               //  Выводим в монитор последовательного порта текст про значение ЧСС
  Serial.print(beatsPerMinute);                         //  Выводим в монитор последовательного порта значение ЧСС
  Serial.print(", Avg BPM=");                           //  Выводим в монитор последовательного порта текст про усреднённую ЧСС
  Serial.print(beatAvg);                                //  Выводим в монитор последовательного порта значение усреднённой ЧСС
  if (irValue < 50000)  Serial.print(" No finger?");    //  Если значение ИК-светодиода меньше указанного, то выводим текст о том, что палец убран с датчика
  Serial.println();                                     //  Выводим в монитор последовательного порта переход на новую строку
}
